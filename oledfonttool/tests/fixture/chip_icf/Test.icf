/* IAR 链接配置样例 */
define symbol __ICFEDIT_intvec_start__ = 0x08000000;
define symbol __ICFEDIT_region_ROM_start__ = 0x08000000;
define symbol __ICFEDIT_region_ROM_end__ = 0x0800FFFF;
define symbol __ICFEDIT_region_ROM_size__ = 0x10000;
define symbol __ICFEDIT_region_RAM_start__ = 0x20000000;
