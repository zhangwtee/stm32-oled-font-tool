#ifndef __OLED_CFONT_H
#define __OLED_CFONT_H

/*==============================================================================
 *  汉字字模库  16x16 点阵，每个汉字 32 字节
 *
 *  取模格式（与 OLED.c 的 OLED_ShowChinese 对应）：
 *      阴码 / 列行式 / 逆向(低位在前) / C51格式
 *      一个汉字 = 2 页 × 16 字节（共 32 字节）
 *
 *  每行的排布：前 3 字节是该字的 UTF-8 编码，后面 32 字节是点阵。
 *  这里全部写成十六进制字节，汉字只放在注释里。
 *
 *  本文件必须是 UTF-8 编码，且 Keil 里 Edit -> Configuration ->
 *  Encoding 也要选 UTF-8，否则源码里的中文字符串无法和这里的编码对上。
 *============================================================================*/

#define OLED_CFONT_W       16
#define OLED_CFONT_H       16
#define OLED_CFONT_BYTES   32
#define OLED_CFONT_STRIDE  35

/* 汉字码表：每行 35 字节 = UTF-8 三字节编码 + 16x16 点阵(32 字节) */
const uint8_t OLED_CF16x16[][35] =
{
	/* 上 */
	0xE4,0xB8,0x8A,0x00,0x00,0x00,0x00,0x00,0x00,0xFF,0x40,0x40,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0x00,
	/* 下 */
	0xE4,0xB8,0x8B,0x01,0x01,0x01,0x01,0x01,0x01,0xFF,0x01,0x01,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0x00,
	/* 世 */
	0xE4,0xB8,0x96,0x20,0x20,0x20,0xFE,0x20,0x20,0xFF,0x20,0x20,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0x00,
	/* 中 */
	0xE4,0xB8,0xAD,0x00,0x00,0xF0,0x10,0x10,0x10,0x10,0xFF,0x10,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0x00,
	/* 你 */
	0xE4,0xBD,0xA0,0x00,0x80,0x60,0xF8,0x07,0x40,0x20,0x18,0x0F,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0x00,
	/* 使 */
	0xE4,0xBD,0xBF,0x80,0x60,0xF8,0x07,0x04,0xE4,0x24,0x24,0x24,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0x00,
	/* 候 */
	0xE5,0x80,0x99,0x80,0x60,0xF8,0x07,0xF8,0x10,0x92,0xF2,0x92,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0x00,
	/* 光 */
	0xE5,0x85,0x89,0x40,0x40,0x42,0x44,0x58,0xC0,0x40,0x7F,0x40,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0x00,
	/* 入 */
	0xE5,0x85,0xA5,0x00,0x00,0x00,0x00,0x00,0x01,0xE2,0x1C,0xE0,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0x00,
	/* 关 */
	0xE5,0x85,0xB3,0x00,0x00,0x10,0x11,0x16,0x10,0x10,0xF0,0x10,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0x00,
	/* 分 */
	0xE5,0x88,0x86,0x80,0x40,0x20,0x90,0x88,0x86,0x80,0x80,0x80,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0x00,
	/* 初 */
	0xE5,0x88,0x9D,0x00,0x08,0x08,0x89,0xEA,0x18,0x88,0x00,0x04,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0x00,
	/* 功 */
	0xE5,0x8A,0x9F,0x00,0x08,0x08,0x08,0xF8,0x08,0x08,0x08,0x10,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0x00,
	/* 化 */
	0xE5,0x8C,0x96,0x00,0x80,0x60,0xF8,0x07,0x00,0x00,0x00,0xFF,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0x00,
	/* 压 */
	0xE5,0x8E,0x8B,0x00,0x00,0xFF,0x01,0x41,0x41,0x41,0x41,0xFD,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0x00,
	/* 发 */
	0xE5,0x8F,0x91,0x00,0x00,0x18,0x16,0x10,0xD0,0xB8,0x97,0x90,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0x00,
	/* 取 */
	0xE5,0x8F,0x96,0x01,0x01,0xFF,0x49,0x49,0x49,0xFF,0x01,0x03,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0x00,
	/* 右 */
	0xE5,0x8F,0xB3,0x08,0x08,0x08,0x08,0xC8,0x38,0x0F,0x08,0x08,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0x00,
	/* 回 */
	0xE5,0x9B,0x9E,0x00,0x00,0xFE,0x02,0x02,0xF2,0x12,0x12,0x12,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0x00,
	/* 好 */
	0xE5,0xA5,0xBD,0x10,0x10,0xF0,0x1F,0x10,0xF0,0x00,0x80,0x82,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0x00,
	/* 始 */
	0xE5,0xA7,0x8B,0x10,0x10,0xF0,0x1F,0x10,0xF0,0x00,0x40,0xE0,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0x00,
	/* 完 */
	0xE5,0xAE,0x8C,0x10,0x0C,0x04,0x24,0x24,0x24,0x25,0x26,0x24,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0x00,
	/* 嵌 */
	0xE5,0xB5,0x8C,0x80,0x80,0xEE,0x88,0x88,0x88,0xE8,0x8F,0x08,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0x00,
	/* 左 */
	0xE5,0xB7,0xA6,0x08,0x08,0x08,0x08,0x88,0x78,0x0F,0x08,0x08,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0x00,
	/* 常 */
	0xE5,0xB8,0xB8,0x20,0x18,0x08,0xEA,0xAC,0xA8,0xA8,0xAF,0xA8,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0x00,
	/* 年 */
	0xE5,0xB9,0xB4,0x00,0x20,0x18,0xC7,0x44,0x44,0x44,0x44,0xFC,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0x00,
	/* 度 */
	0xE5,0xBA,0xA6,0x00,0x00,0xFC,0x24,0x24,0x24,0xFC,0x25,0x26,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0x00,
	/* 开 */
	0xE5,0xBC,0x80,0x40,0x41,0x41,0x41,0xFF,0x41,0x41,0x41,0x41,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0x00,
	/* 式 */
	0xE5,0xBC,0x8F,0x10,0x10,0x90,0x90,0x90,0x90,0x90,0x10,0x10,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0x00,
	/* 态 */
	0xE6,0x80,0x81,0x00,0x04,0x84,0x84,0x44,0x24,0x54,0x8F,0x14,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0x00,
	/* 成 */
	0xE6,0x88,0x90,0x00,0x00,0xF8,0x88,0x88,0x88,0x88,0x08,0x08,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0x00,
	/* 报 */
	0xE6,0x8A,0xA5,0x10,0x10,0x10,0xFF,0x10,0x90,0x00,0xFE,0x82,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0x00,
	/* 文 */
	0xE6,0x96,0x87,0x08,0x08,0x08,0x38,0xC8,0x08,0x09,0x0E,0x08,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0x00,
	/* 日 */
	0xE6,0x97,0xA5,0x00,0x00,0x00,0xFF,0x41,0x41,0x41,0x41,0x41,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0x00,
	/* 时 */
	0xE6,0x97,0xB6,0x00,0xFC,0x84,0x84,0x84,0xFC,0x00,0x10,0x10,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0x00,
	/* 月 */
	0xE6,0x9C,0x88,0x00,0x00,0x00,0x00,0xFF,0x11,0x11,0x11,0x11,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0x00,
	/* 机 */
	0xE6,0x9C,0xBA,0x10,0x10,0xD0,0xFF,0x90,0x10,0x00,0xFE,0x02,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0x00,
	/* 欢 */
	0xE6,0xAC,0xA2,0x04,0x24,0x44,0x84,0x64,0x9C,0x40,0x30,0x0F,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0x00,
	/* 正 */
	0xE6,0xAD,0xA3,0x00,0x02,0x02,0xC2,0x02,0x02,0x02,0xFE,0x82,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0x00,
	/* 流 */
	0xE6,0xB5,0x81,0x10,0x60,0x02,0x8C,0x00,0x44,0x64,0x54,0x4D,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0x00,
	/* 测 */
	0xE6,0xB5,0x8B,0x00,0x10,0x60,0x02,0x8C,0x00,0xFE,0x02,0xF2,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0x00,
	/* 消 */
	0xE6,0xB6,0x88,0x00,0x10,0x60,0x02,0x0C,0xC0,0x00,0xE2,0x2C,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0x00,
	/* 温 */
	0xE6,0xB8,0xA9,0x10,0x60,0x02,0x8C,0x00,0x00,0xFE,0x92,0x92,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0x00,
	/* 湿 */
	0xE6,0xB9,0xBF,0x10,0x60,0x02,0x8C,0x00,0xFE,0x92,0x92,0x92,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0x00,
	/* 照 */
	0xE7,0x85,0xA7,0x00,0x00,0xFF,0x21,0x21,0x21,0xFF,0x00,0x21,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0x00,
	/* 状 */
	0xE7,0x8A,0xB6,0x00,0x08,0x30,0x00,0xFF,0x20,0x20,0x20,0x20,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0x00,
	/* 率 */
	0xE7,0x8E,0x87,0x00,0x14,0xA4,0x44,0x24,0x34,0xAD,0x66,0x24,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0x00,
	/* 用 */
	0xE7,0x94,0xA8,0x00,0x00,0x00,0xFF,0x11,0x11,0x11,0x11,0xFF,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0x00,
	/* 电 */
	0xE7,0x94,0xB5,0x00,0xF8,0x88,0x88,0x88,0x88,0xFF,0x88,0x88,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0x00,
	/* 界 */
	0xE7,0x95,0x8C,0x00,0x00,0x00,0x7F,0x49,0x49,0xC9,0x7F,0xC9,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0x00,
	/* 确 */
	0xE7,0xA1,0xAE,0x04,0x84,0xE4,0x5C,0x44,0xC4,0x20,0x10,0xE8,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0x00,
	/* 秒 */
	0xE7,0xA7,0x92,0x24,0x24,0xA4,0xFE,0x23,0x22,0x00,0xC0,0x38,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0x00,
	/* 稍 */
	0xE7,0xA8,0x8D,0x00,0x24,0x24,0xA4,0xFE,0x23,0x22,0x00,0xE2,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0x00,
	/* 系 */
	0xE7,0xB3,0xBB,0x00,0x00,0x22,0x32,0x2A,0xA6,0xA2,0x62,0x21,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0x00,
	/* 统 */
	0xE7,0xBB,0x9F,0x20,0x30,0xAC,0x63,0x30,0x00,0x88,0xC8,0xA8,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0x00,
	/* 网 */
	0xE7,0xBD,0x91,0x00,0xFF,0x01,0x11,0x21,0xC1,0x39,0x01,0x11,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0x00,
	/* 置 */
	0xE7,0xBD,0xAE,0x00,0x17,0x15,0xD5,0x55,0x57,0x55,0x7D,0x55,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0x00,
	/* 行 */
	0xE8,0xA1,0x8C,0x00,0x10,0x88,0xC4,0x33,0x00,0x40,0x42,0x42,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0x00,
	/* 警 */
	0xE8,0xAD,0xA6,0x12,0xEA,0xAF,0xAA,0xEA,0x0F,0xFA,0x02,0x88,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0x00,
	/* 认 */
	0xE8,0xAE,0xA4,0x40,0x40,0x42,0xCC,0x00,0x00,0x00,0x00,0x00,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0x00,
	/* 设 */
	0xE8,0xAE,0xBE,0x20,0x20,0x21,0xE6,0x00,0x20,0x50,0xCF,0x41,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0x00,
	/* 试 */
	0xE8,0xAF,0x95,0x40,0x40,0x42,0xCC,0x00,0x90,0x90,0x90,0x90,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0x00,
	/* 误 */
	0xE8,0xAF,0xAF,0x20,0x21,0xE6,0x00,0x00,0x40,0x4F,0x49,0x49,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0x00,
	/* 请 */
	0xE8,0xAF,0xB7,0x40,0x42,0xCC,0x00,0x00,0x44,0x54,0x54,0x54,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0x00,
	/* 迎 */
	0xE8,0xBF,0x8E,0x40,0x40,0x42,0xCC,0x00,0x00,0xFC,0x04,0x02,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0x00,
	/* 运 */
	0xE8,0xBF,0x90,0x40,0x40,0x42,0xCC,0x00,0x20,0x22,0x22,0xA2,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0x00,
	/* 返 */
	0xE8,0xBF,0x94,0x40,0x40,0x42,0xCC,0x00,0x00,0xFC,0x24,0xA4,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0x00,
	/* 量 */
	0xE9,0x87,0x8F,0x10,0x10,0x10,0xDF,0x55,0x55,0x55,0xD5,0x55,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0x00,
	/* 错 */
	0xE9,0x94,0x99,0x40,0x30,0xEF,0x24,0x64,0x48,0x48,0x7F,0x48,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0x00,
	/* 间 */
	0xE9,0x97,0xB4,0x00,0xF8,0x01,0x06,0x00,0xF0,0x12,0x12,0x12,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0x00,
};

/* 汉字个数 */
#define OLED_CFONT_TABLE   OLED_CF16x16
#define OLED_CFONT_NUM     (sizeof(OLED_CFONT_TABLE) / sizeof(OLED_CFONT_TABLE[0]))
#define OLED_CF16x16_NUM   OLED_CFONT_NUM

/* ============================================================================
 *  适配区：只改这里，下面的函数不用动
 *
 *  这里不假设你工程里已经写好 OLED_ShowChinese —— 很多工程没有，或者参数
 *  顺序、页数算法各不相同。本文件只跟驱动交换两个最底层的动作：
 *  写一条命令、写一个字节。这两个函数初始化时必然要用到，不可能不存在。
 *
 *  (A) 命令和数据分成两个函数（中景园新版、多数 HAL 例程）
 *      #define CF_WRITE_CMD(c)   OLED_WriteCommand(c)
 *      #define CF_WRITE_DATA(d)  OLED_WriteData(d)
 *
 *  (B) 一个函数加 cmd 标志位（正点原子、中景园旧版）
 *      #define CF_WRITE_CMD(c)   OLED_WR_Byte((c), 1)
 *      #define CF_WRITE_DATA(d)  OLED_WR_Byte((d), 0)
 *
 *  有些工程把这两个函数只写在 .c 里、没在 .h 声明，在自己文件里调用会报
 *  未声明。把这两行补进对应的 .h 即可：
 *      void OLED_WriteCommand(uint8_t cmd);
 *      void OLED_WriteData(uint8_t dat);
 *
 *  CF_SHOW_ASCII 用来显示英文字符。没有自己的字符显示函数就改成
 *      #define CF_SHOW_ASCII(line, col, ch)  ((void)0)
 *  这样英文字符被跳过，汉字位置仍然连续。
 * ========================================================================== */
#define CF_WRITE_CMD(c)                 OLED_WriteCommand(c)
#define CF_WRITE_DATA(d)                OLED_WriteData(d)
#define CF_SHOW_ASCII(line, col, ch)    OLED_ShowChar((line), (col), (ch))

/* 屏是 SH1106（显存 132 列，可见区从第 2 列开始）时改成 2，SSD1306 保持 0 */
#define CF_COL_OFFSET                   0

/* 屏幕像素宽度，只用来判断一行写满后不再往后写 */
#define CF_SCREEN_W                     128

/* 屏幕像素高度，只用来判断行号是否超出屏幕 */
#define CF_SCREEN_H                     64

/* 一个汉字占几页 */
#define OLED_CFONT_PAGES                (OLED_CFONT_H / 8)

#if defined(__GNUC__) || defined(__CC_ARM)
#define CF_UNUSED  __attribute__((unused))
#else
#define CF_UNUSED
#endif

/* 定位到某一页、某一像素列。自己发命令，不调用驱动里的设光标函数，
   免得碰上各例程参数顺序不一致（有的页在前，有的列在前） */
#define CF_SET_POS(page, col)                                          \
    do {                                                               \
        CF_WRITE_CMD((uint8_t)(0xB0 | ((page) & 0x07)));                \
        CF_WRITE_CMD((uint8_t)(0x10 | (((col) >> 4) & 0x0F)));          \
        CF_WRITE_CMD((uint8_t)(0x00 | ((col) & 0x0F)));                 \
    } while (0)

/* 在码表里找这个字，返回点阵起始地址；找不到返回 0。
   utf8 指向该字 3 字节 UTF-8 编码的第一个字节。 */
static CF_UNUSED const uint8_t *OLED_CFont_Find(const char *utf8)
{
    uint16_t i;

    for (i = 0; i < (uint16_t)OLED_CFONT_NUM; i++)
    {
        if (OLED_CFONT_TABLE[i][0] == (uint8_t)utf8[0] &&
            OLED_CFONT_TABLE[i][1] == (uint8_t)utf8[1] &&
            OLED_CFONT_TABLE[i][2] == (uint8_t)utf8[2])
        {
            return &OLED_CFONT_TABLE[i][3];
        }
    }
    return 0;
}

/* 把一个字的点阵写到屏上。
   line   : 第几行文字（从 1 开始），一行占 OLED_CFONT_PAGES 页
   xPixel : 起始像素列（0 起），不是"第几个字" */
static CF_UNUSED void OLED_CFont_ShowGlyph(uint8_t line, uint16_t xPixel,
                                           const uint8_t *glyph)
{
    uint8_t  p;
    uint8_t  x;
    uint16_t base;

    if (glyph == 0 || (uint16_t)(xPixel + OLED_CFONT_W) > CF_SCREEN_W)
    {
        return;
    }

    base = (uint16_t)((line - 1) * OLED_CFONT_PAGES);
    if ((uint16_t)(base + OLED_CFONT_PAGES) > (uint16_t)(CF_SCREEN_H / 8))
    {
        return;                 /* 整行放不下了，不写。否则页地址会绕回第 0 页 */
    }

    for (p = 0; p < OLED_CFONT_PAGES; p++)
    {
        CF_SET_POS(base + p, (uint16_t)(xPixel + CF_COL_OFFSET));
        for (x = 0; x < OLED_CFONT_W; x++)
        {
            CF_WRITE_DATA(glyph[(uint16_t)p * OLED_CFONT_W + x]);
        }
    }
}

/* 显示一串 UTF-8 编码的文字（汉字 + 英文 + 数字混排）。
   line : 第几行文字（从 1 开始）
   col  : 从第几列开始，单位是 8 像素，和 OLED_ShowString 的 Column 一致。
          所以 16x16 的汉字占 2 列，24x24 占 3 列，32x32 占 4 列。

   注意：英文字符委托给 CF_SHOW_ASCII，它按 8x16 字符计算行位置。
   字号不是 16 时，英文和汉字的行高不一致，混排会错开，这种情况自己调 line。 */
static CF_UNUSED void OLED_CFont_ShowString(uint8_t line, uint8_t col,
                                            const char *utf8)
{
    const uint8_t *g;
    uint16_t xPixel;
    uint8_t  c;

    if (utf8 == 0)
    {
        return;
    }
    if (col < 1)
    {
        col = 1;
    }
    xPixel = (uint16_t)((col - 1) * 8);

    while (*utf8 != '\0')
    {
        c = (uint8_t)(*utf8);

        if (c < 0x80)                       /* ASCII */
        {
            if ((uint16_t)(xPixel + 8) <= CF_SCREEN_W)
            {
                CF_SHOW_ASCII(line, (uint8_t)(xPixel / 8 + 1), (char)c);
            }
            xPixel = (uint16_t)(xPixel + 8);
            utf8++;
        }
        else if ((c & 0xF0) == 0xE0)        /* 三字节：本字库收录的汉字 */
        {
            g = OLED_CFont_Find(utf8);
            if (g != 0)
            {
                OLED_CFont_ShowGlyph(line, xPixel, g);
            }
            xPixel = (uint16_t)(xPixel + OLED_CFONT_W);
            utf8 += 3;
        }
        else if ((c & 0xF8) == 0xF0)        /* 四字节：扩展区汉字，本库不收 */
        {
            xPixel = (uint16_t)(xPixel + OLED_CFONT_W * 2);
            utf8 += 4;
        }
        else if ((c & 0xE0) == 0xC0)        /* 二字节：拉丁扩展等，本库不收 */
        {
            xPixel = (uint16_t)(xPixel + 8);
            utf8 += 2;
        }
        else                                /* 非法字节，跳过一个继续 */
        {
            utf8++;
        }
    }
}

#endif
